## examples/google_voice_assistant/main/Kconfig.projbuild
```kconfig
menu "Voice Assistant Configurations"

config VOICE_ASSISTANT_TASK_LIST
    bool "Enable task list print at delete stream"
    default n
    depends on FREERTOS_USE_STATS_FORMATTING_FUNCTIONS
    help
        Prints all the tasks which are running as well as blocked.

config DEVICE_MODEL
    string "DEVICE_MODEL"
	default "device-model-default"
	help
		Device model for the example to connect gva.

config DEVICE_ID
    string "DEVICE_ID"
	default "device-id-default"
	help
		Device ID (unique) for the example to use.

config DEVICE_LANG
    string "DEVICE_LANG"
	default "device-lang-default"
	help
		Device LANG for the example to use.

endmenu
```
